#include <Arduino.h>
#include <SPI.h>
#include <Adafruit_GFX.h>
#include <Adafruit_PCD8544.h>

// Pin definitions for LCD
#define RST 14
#define CE  5
#define DC  19
#define DIN 23
#define CLK 18

// Pin definitions for buttons
#define BTN_UP     12
#define BTN_DOWN   27
#define BTN_SELECT 26
#define BTN_BACK   25

Adafruit_PCD8544 display = Adafruit_PCD8544(CLK, DIN, DC, CE, RST);

const char *menuItems[] = {"Read", "Write", "Save", "Emulate"};
const int menuSize = sizeof(menuItems) / sizeof(menuItems[0]);
int currentSelection = 0;
bool inSubMenu = false;
int subMenuSelection = 0;

// Button debounce variables
unsigned long lastDebounceTime = 0;
const unsigned long debounceDelay = 200;




// Auto mode images (cycled every second)
const uint8_t autoImage1[504] = { 
  0xfe, 0x05, 0x06, 0xfd, 0x5a, 0x55, 0xfa, 0x05, 0x06, 0xfd, 0x06, 0x05,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 0x55, 
  0xff, 0x80, 0x80, 0xff, 0x80, 0x80, 0xff, 0x80, 0x80, 0xff, 0x80, 0x80,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 0x55, 
  0xaa, 0x56, 0xaa, 0xd6, 0x6a, 0x56, 0xea, 0x56, 0xaa, 0xf6, 0x1a, 0x16,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 0x55, 
  0x9e, 0x9f, 0x9e, 0x9f, 0x90, 0xf0, 0xff, 0x01, 0x01, 0xff, 0x00, 0x00,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 0x55, 
  0xe0, 0xff, 0xe0, 0xe0, 0xee, 0xe0, 0xe0, 0x3f, 0xfd, 0x55, 0x6d, 0x55,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 0x03, 
  0x03, 0x03, 0x03, 0x03, 0x03, 0x03, 0x03, 0x03, 0x03, 0x03, 0x02, 0x02,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 0x3e
};
const uint8_t autoImage2[504] = { 
  0xfe, 0x05, 0x06, 0xfd, 0x5a, 0x55, 0xfa, 0x05, 0x06, 0xfd, 0x06, 0x05,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 0x55, 
  0xff, 0x80, 0x80, 0xff, 0x80, 0x80, 0xff, 0x80, 0x80, 0xff, 0x80, 0x80,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 0x55, 
  0xaa, 0x56, 0xaa, 0xd6, 0x6a, 0x56, 0xea, 0x56, 0xaa, 0xf6, 0x1a, 0x16,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 0x55, 
  0x9e, 0x9f, 0x9e, 0x9f, 0x90, 0xf0, 0xff, 0x01, 0x01, 0xff, 0x00, 0x00,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 0x55, 
  0xe0, 0xff, 0xe0, 0xe0, 0xee, 0xe0, 0xe0, 0x3f, 0xfd, 0x55, 0x6d, 0x55,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 0x03, 
  0x03, 0x03, 0x03, 0x03, 0x03, 0x03, 0x03, 0x03, 0x03, 0x03, 0x02, 0x02,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 0x3e
};
const uint8_t autoImage3[504] = { 
  0xfe, 0x05, 0x06, 0xfd, 0x5a, 0x55, 0xfa, 0x05, 0x06, 0xfd, 0x06, 0x05,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 0x55, 
  0xff, 0x80, 0x80, 0xff, 0x80, 0x80, 0xff, 0x80, 0x80, 0xff, 0x80, 0x80,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 0x55, 
  0xaa, 0x56, 0xaa, 0xd6, 0x6a, 0x56, 0xea, 0x56, 0xaa, 0xf6, 0x1a, 0x16,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 0x55, 
  0x9e, 0x9f, 0x9e, 0x9f, 0x90, 0xf0, 0xff, 0x01, 0x01, 0xff, 0x00, 0x00,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 0x55, 
  0xe0, 0xff, 0xe0, 0xe0, 0xee, 0xe0, 0xe0, 0x3f, 0xfd, 0x55, 0x6d, 0x55,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 0x03, 
  0x03, 0x03, 0x03, 0x03, 0x03, 0x03, 0x03, 0x03, 0x03, 0x03, 0x02, 0x02,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 0x3e
};
const uint8_t autoImage4[504] ={ 
  0xfe, 0x05, 0x06, 0xfd, 0x5a, 0x55, 0xfa, 0x05, 0x06, 0xfd, 0x06, 0x05,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 0x55, 
  0xff, 0x80, 0x80, 0xff, 0x80, 0x80, 0xff, 0x80, 0x80, 0xff, 0x80, 0x80,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 0x55, 
  0xaa, 0x56, 0xaa, 0xd6, 0x6a, 0x56, 0xea, 0x56, 0xaa, 0xf6, 0x1a, 0x16,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 0x55, 
  0x9e, 0x9f, 0x9e, 0x9f, 0x90, 0xf0, 0xff, 0x01, 0x01, 0xff, 0x00, 0x00,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 0x55, 
  0xe0, 0xff, 0xe0, 0xe0, 0xee, 0xe0, 0xe0, 0x3f, 0xfd, 0x55, 0x6d, 0x55,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 0x03, 
  0x03, 0x03, 0x03, 0x03, 0x03, 0x03, 0x03, 0x03, 0x03, 0x03, 0x02, 0x02,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 0x3e
};
const uint8_t autoImage5[504] = { 
  0x00, 0x00, 0x00, 0x00, 0xc0, 0x20, 0x20, 0xc0, 0x00, 0x00, 0x00, 0x00,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 0x00, 
  0x02, 0x02, 0x01, 0x01, 0x00, 0xc0, 0xb0, 0x8f, 0x80, 0x80, 0x80, 0x80,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 0x00, 
  0x18, 0x0c, 0x0c, 0x06, 0x03, 0x03, 0x01, 0x01, 0x00, 0x00, 0x00, 0x00,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 0xfc, 
  0xdc, 0xdc, 0xec, 0xec, 0xfc, 0xf4, 0xfc, 0xfc, 0xfc, 0x00, 0x00, 0x00,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 0xff, 
  0xff, 0xff, 0xff, 0xff, 0xff, 0xff, 0xff, 0xff, 0xff, 0x01, 0x02, 0x32,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 0xff, 
  0xff, 0xff, 0xff, 0xff, 0xff, 0xff, 0xff, 0xff, 0xff, 0x08, 0x08, 0x08,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 0xff
};

const uint8_t autoImage6[504] = { 
  0x00, 0x00, 0x00, 0x00, 0x00, 0x00, 0x00, 0x00, 0x00, 0x00, 0x80, 0x80,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 0x00, 
  0x02, 0x02, 0x02, 0x02, 0x02, 0x02, 0x02, 0x01, 0x01, 0x01, 0x00, 0x80,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 0x00, 
  0x08, 0x04, 0x04, 0x04, 0x04, 0x02, 0x02, 0x02, 0x02, 0x01, 0x01, 0x00,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 0xfc, 
  0xdf, 0xdc, 0xec, 0xec, 0xfc, 0xf4, 0xfc, 0xfc, 0xfc, 0x00, 0x00, 0x00,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 0xff, 
  0xff, 0xff, 0xff, 0xff, 0xff, 0xff, 0xff, 0xff, 0xff, 0x01, 0x02, 0x32,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 0xff, 
  0xff, 0xff, 0xff, 0xff, 0xff, 0xff, 0xff, 0xff, 0xff, 0x08, 0x08, 0x08,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 0xff
};
const uint8_t autoImage7[504] = { 
  0x00, 0x00, 0x00, 0x00, 0xc0, 0x20, 0x20, 0xc0, 0x00, 0x00, 0x00, 0x00,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 0x00, 
  0x02, 0x02, 0x01, 0x01, 0x00, 0xc0, 0xb0, 0x8f, 0x80, 0x80, 0x80, 0x80,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 0x00, 
  0x18, 0x0c, 0x0c, 0x06, 0x03, 0x03, 0x01, 0x01, 0x00, 0x00, 0x00, 0x00,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 0xfc, 
  0xdc, 0xdc, 0xec, 0xec, 0xfc, 0xf4, 0xfc, 0xfc, 0xfc, 0x00, 0x00, 0x00,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 0xff, 
  0xff, 0xff, 0xff, 0xff, 0xff, 0xff, 0xff, 0xff, 0xff, 0x01, 0x02, 0x32,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 0xff, 
  0xff, 0xff, 0xff, 0xff, 0xff, 0xff, 0xff, 0xff, 0xff, 0x08, 0x08, 0x08,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 0xff
};
const uint8_t autoImage8[504] = { 
  0x00, 0x00, 0x00, 0x00, 0xc0, 0x20, 0x20, 0xc0, 0x00, 0x00, 0x00, 0x00,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 0x00, 
  0x02, 0x02, 0x01, 0x01, 0x00, 0xc0, 0xb0, 0x8f, 0x80, 0x80, 0x80, 0x80,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 0x00, 
  0x08, 0x04, 0x04, 0x02, 0x01, 0x00, 0x00, 0x00, 0x00, 0x00, 0x00, 0x00,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 0xfc, 
  0xdc, 0xdc, 0xec, 0xec, 0xfc, 0xf4, 0xfc, 0xfc, 0xfc, 0x00, 0x00, 0x00,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 0xff, 
  0xff, 0xff, 0xff, 0xff, 0xff, 0xff, 0xff, 0xff, 0xff, 0x01, 0x02, 0x32,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 0xff, 
  0xff, 0xff, 0xff, 0xff, 0xff, 0xff, 0xff, 0xff, 0xff, 0x08, 0x08, 0x08,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 0xff
};
const uint8_t autoImage9[504] = { 
  0x00, 0x00, 0x00, 0x00, 0xc0, 0x20, 0x20, 0xc0, 0x00, 0x00, 0x00, 0x00,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 0x00, 
  0x02, 0x02, 0x01, 0x01, 0x00, 0xc0, 0xb0, 0x8f, 0x80, 0x80, 0x80, 0x80,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 0x00, 
  0x18, 0x0c, 0x0c, 0x06, 0x03, 0x03, 0x01, 0x01, 0x00, 0x00, 0x00, 0x00,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 0xfc, 
  0xdc, 0xdc, 0xec, 0xec, 0xfc, 0xf4, 0xfc, 0xfc, 0xfc, 0x00, 0x00, 0x00,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 0xff, 
  0xff, 0xff, 0xff, 0xff, 0xff, 0xff, 0xff, 0xff, 0xff, 0x01, 0x02, 0x32,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 0xff, 
  0xff, 0xff, 0xff, 0xff, 0xff, 0xff, 0xff, 0xff, 0xff, 0x08, 0x08, 0x08,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 0xff
};
const uint8_t autoImage10[504] = { 
  0x00, 0x00, 0x00, 0x00, 0xc0, 0x20, 0x20, 0xc0, 0x00, 0x00, 0x00, 0x00,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 0x00, 
  0x02, 0x02, 0x01, 0x01, 0x00, 0xc0, 0xb0, 0x8f, 0x80, 0x80, 0x80, 0x80,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 0x00, 
  0x08, 0x04, 0x04, 0x02, 0x01, 0x00, 0x00, 0x00, 0x00, 0x00, 0x00, 0x00,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 0xfc, 
  0xdc, 0xdc, 0xec, 0xec, 0xfc, 0xf4, 0xfc, 0xfc, 0xfc, 0x00, 0x00, 0x00,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 0xff, 
  0xff, 0xff, 0xff, 0xff, 0xff, 0xff, 0xff, 0xff, 0xff, 0x01, 0x02, 0x32,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 0xff, 
  0xff, 0xff, 0xff, 0xff, 0xff, 0xff, 0xff, 0xff, 0xff, 0x08, 0x08, 0x08,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 0xff
};
const uint8_t autoImage11[504] = { 
  0x00, 0x00, 0x00, 0x00, 0xc0, 0x20, 0x20, 0xc0, 0x00, 0x00, 0x00, 0x00,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 0x00, 
  0x02, 0x02, 0x01, 0x01, 0x00, 0xc0, 0xb0, 0x8f, 0x80, 0x80, 0x80, 0x80,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 0x00, 
  0x18, 0x0c, 0x0c, 0x06, 0x03, 0x03, 0x01, 0x01, 0x00, 0x00, 0x00, 0x00,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 0xfc, 
  0xdc, 0xdc, 0xec, 0xec, 0xfc, 0xf4, 0xfc, 0xfc, 0xfc, 0x00, 0x00, 0x00,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 0xff, 
  0xff, 0xff, 0xff, 0xff, 0xff, 0xff, 0xff, 0xff, 0xff, 0x01, 0x02, 0x32,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 0xff, 
  0xff, 0xff, 0xff, 0xff, 0xff, 0xff, 0xff, 0xff, 0xff, 0x08, 0x08, 0x08,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 0xff
};
const uint8_t autoImage12[504] = { 
  0xff, 0xff, 0xff, 0xff, 0xff, 0xff, 0xff, 0xff, 0xff, 0xff, 0xfb, 0xff,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 0xff, 
  0xff, 0xff, 0xff, 0xff, 0xff, 0xff, 0xff, 0xff, 0xff, 0xff, 0xff, 0xff,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 0xbf, 
  0xff, 0xff, 0xff, 0xff, 0xff, 0xff, 0xff, 0x7f, 0x9f, 0xef, 0x33, 0x1d,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 0x43, 
  0xff, 0xff, 0xff, 0x7f, 0x8f, 0xf3, 0x1c, 0x07, 0x01, 0x00, 0x00, 0x00,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 0x10, 
  0xff, 0x8f, 0xf3, 0x5c, 0xc7, 0x80, 0x00, 0x00, 0x00, 0x00, 0x00, 0x00,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 0x02, 
  0xff, 0xff, 0xff, 0xff, 0xfe, 0xfd, 0xfb, 0xf6, 0xec, 0xf8, 0xd8, 0xf0,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 0x48
};









const uint8_t* autoImages[] = {autoImage1, autoImage2, autoImage3, autoImage4, autoImage5,autoImage6,autoImage7,autoImage8,autoImage9,autoImage10,autoImage11,autoImage12};
const int totalAutoImages = 12;

// Manual mode images (user navigates)
const uint8_t manualImage1[504] = { 
  0xfe, 0x01, 0xfd, 0x05, 0xe5, 0x35, 0x75, 0x75, 0xf5, 0xf5, 0x75, 0x75,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 0x5f, 
  0x7f, 0x80, 0x9f, 0xb0, 0xb1, 0xb7, 0xb3, 0xb3, 0xb7, 0xb7, 0xb3, 0xb3,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 0x55, 
  0x00, 0x00, 0xe0, 0x10, 0xc8, 0x20, 0x80, 0x00, 0x80, 0x80, 0x00, 0x80,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 0x55, 
  0x00, 0x00, 0x07, 0x08, 0x13, 0x04, 0x01, 0x00, 0x7d, 0x7d, 0x00, 0x01,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 0x55, 
  0x00, 0x00, 0x00, 0x00, 0xe0, 0xf0, 0xe0, 0x00, 0xe0, 0xf0, 0xe0, 0x00,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 0x55, 
  0x00, 0x00, 0x00, 0x3c, 0x04, 0x15, 0x04, 0x3c, 0x04, 0x15, 0x04, 0x3c,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 0x55
};
const uint8_t manualImage2[504] = { 
  0x00, 0x00, 0xfc, 0x04, 0xe4, 0x34, 0x74, 0x74, 0xf4, 0xf4, 0x74, 0x74,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 0xf5, 
  0x00, 0x00, 0x1f, 0x30, 0x31, 0x37, 0x33, 0x33, 0x37, 0x37, 0x33, 0x33,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 0x55, 
  0xfc, 0x02, 0xe2, 0x12, 0xca, 0x22, 0x82, 0x02, 0x82, 0x82, 0x02, 0x82,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 0x55, 
  0xff, 0x00, 0x07, 0x08, 0x13, 0x04, 0x01, 0x00, 0x7d, 0x7d, 0x00, 0x01,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 0x55, 
  0x00, 0x01, 0x01, 0x01, 0xe1, 0xf1, 0xe1, 0x01, 0xe1, 0xf1, 0xe1, 0x01,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 0x55, 
  0x00, 0x00, 0x00, 0x3c, 0x04, 0x15, 0x04, 0x3c, 0x04, 0x15, 0x04, 0x3c,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 0x55
};
const uint8_t manualImage3[504] ={ 
  0x00, 0x00, 0xfc, 0x04, 0xe4, 0x34, 0x74, 0x74, 0xf4, 0xf4, 0x74, 0x74,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 0x55, 
  0x00, 0x00, 0x1f, 0x30, 0x31, 0x37, 0x33, 0x33, 0x37, 0x37, 0x33, 0x33,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 0x7d, 
  0x00, 0x00, 0xe0, 0x10, 0xc8, 0x20, 0x80, 0x00, 0x80, 0x80, 0x00, 0x80,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 0x55, 
  0x00, 0x00, 0x07, 0x08, 0x13, 0x04, 0x01, 0x00, 0x7d, 0x7d, 0x00, 0x01,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 0x55, 
  0xf8, 0x04, 0x04, 0x04, 0xe4, 0xf4, 0xe4, 0x04, 0xe4, 0xf4, 0xe4, 0x04,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 0x55, 
  0xff, 0x80, 0x80, 0xbc, 0x84, 0x95, 0x84, 0xbc, 0x84, 0x95, 0x84, 0xbc,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 0x55
}; 
const uint8_t manualImage4[504] = { 
  0xfe, 0x01, 0x01, 0x21, 0x41, 0x81, 0xf1, 0x11, 0xa1, 0x41, 0x01, 0x41,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 0x55, 
  0x7f, 0x80, 0x80, 0x88, 0x84, 0x82, 0x9f, 0x91, 0x8a, 0x84, 0x80, 0x84,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 0x55, 
  0x00, 0x00, 0x00, 0x00, 0xc0, 0x60, 0x60, 0xc0, 0x80, 0x00, 0x00, 0x00,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 0x7d, 
  0x00, 0x00, 0x00, 0x00, 0x0f, 0x10, 0x00, 0x00, 0x01, 0x03, 0x06, 0x0c,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 0x55, 
  0x00, 0x00, 0x20, 0x10, 0x08, 0x48, 0x28, 0xa8, 0xa8, 0xa8, 0xa8, 0xa8,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 0x55, 
  0x00, 0x00, 0x00, 0x10, 0x10, 0x10, 0x18, 0x1c, 0x1e, 0x1e, 0x1e, 0x1c,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 0x55
}; 
const uint8_t manualImage5[504] = { 
  0x00, 0x00, 0x00, 0x20, 0x40, 0x80, 0xf0, 0x10, 0xa0, 0x40, 0x00, 0x40,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 0x5f, 
  0x00, 0x00, 0x00, 0x08, 0x04, 0x02, 0x1f, 0x11, 0x0a, 0x04, 0x00, 0x04,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 0x55, 
  0xfe, 0x01, 0x01, 0x01, 0xc1, 0x61, 0x61, 0xc1, 0x81, 0x01, 0x01, 0x01,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 0x55, 
  0x7f, 0x80, 0x80, 0x80, 0x8f, 0x90, 0x80, 0x80, 0x81, 0x83, 0x86, 0x8c,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 0x55, 
  0x00, 0x00, 0x20, 0x10, 0x08, 0x48, 0x28, 0xa8, 0xa8, 0xa8, 0xa8, 0xa8,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 0x55, 
  0x00, 0x00, 0x00, 0x10, 0x10, 0x10, 0x18, 0x1c, 0x1e, 0x1e, 0x1e, 0x1c,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 0x55
};
const uint8_t manualImage6[504] = { 
  0x00, 0x00, 0x00, 0x40, 0x80, 0x00, 0xe0, 0x20, 0x40, 0x80, 0x00, 0x80,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 0x55, 
  0x00, 0x00, 0x00, 0x10, 0x08, 0x05, 0x3f, 0x22, 0x15, 0x08, 0x00, 0x08,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 0x55, 
  0x00, 0x00, 0x00, 0x00, 0xc0, 0x60, 0x60, 0xc0, 0x80, 0x00, 0x00, 0x00,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 0xd5, 
  0x00, 0x00, 0x00, 0x00, 0x0f, 0x10, 0x00, 0x00, 0x01, 0x03, 0x06, 0x0c,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 0x57, 
  0xfe, 0x01, 0x21, 0x11, 0x09, 0x49, 0x29, 0xa9, 0xa9, 0xa9, 0xa9, 0xa9,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 0x55, 
  0x7f, 0x80, 0x80, 0x90, 0x90, 0x90, 0x98, 0x9c, 0x9e, 0x9e, 0x9e, 0x9c,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 0x55
};
const uint8_t manualImage7[504] ={ 
  0xfe, 0x01, 0x01, 0xf1, 0x51, 0x51, 0x51, 0x51, 0x51, 0x61, 0x41, 0x41,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 0x55, 
  0x7f, 0x80, 0x80, 0x9f, 0xa0, 0xa0, 0xa0, 0xa0, 0xa0, 0xa0, 0xa0, 0xa0,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 0x55, 
  0x00, 0x00, 0x00, 0xe0, 0x10, 0xc8, 0x28, 0x28, 0x28, 0xc8, 0x10, 0xe0,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 0x55, 
  0x00, 0x00, 0x00, 0x03, 0x04, 0x08, 0x11, 0x21, 0x11, 0x08, 0x04, 0x03,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 0x55, 
  0x00, 0x00, 0x80, 0x40, 0x20, 0x90, 0x50, 0x50, 0x50, 0x50, 0x50, 0x50,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 0x5f, 
  0x00, 0x00, 0x00, 0x00, 0x01, 0x00, 0x02, 0x01, 0x0d, 0x0d, 0x01, 0x02,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 0x55
};
const uint8_t manualImage8[504] ={ 
  0x00, 0x00, 0x00, 0xf0, 0x50, 0x50, 0x50, 0x50, 0x50, 0x60, 0x40, 0x40,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 0x55, 
  0x00, 0x00, 0x00, 0x1f, 0x20, 0x20, 0x20, 0x20, 0x20, 0x20, 0x20, 0x20,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 0x55, 
  0xfe, 0x01, 0x01, 0xe1, 0x11, 0xc9, 0x29, 0x29, 0x29, 0xc9, 0x11, 0xe1,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 0x55, 
  0x7f, 0x80, 0x80, 0x83, 0x84, 0x88, 0x91, 0xa1, 0x91, 0x88, 0x84, 0x83,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 0x55, 
  0x00, 0x00, 0x80, 0x40, 0x20, 0x90, 0x50, 0x50, 0x50, 0x50, 0x50, 0x50,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 0xd5, 
  0x00, 0x00, 0x00, 0x00, 0x01, 0x00, 0x02, 0x01, 0x0d, 0x0d, 0x01, 0x02,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 0x57
};
const uint8_t manualImage9[504] ={ 
  0x00, 0x00, 0x00, 0xf0, 0x50, 0x50, 0x50, 0x50, 0x50, 0x60, 0x40, 0x40,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 0x55, 
  0x00, 0x00, 0x00, 0x1f, 0x20, 0x20, 0x20, 0x20, 0x20, 0x20, 0x20, 0x20,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 0x55, 
  0x00, 0x00, 0x00, 0xe0, 0x10, 0xc8, 0x28, 0x28, 0x28, 0xc8, 0x10, 0xe0,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 0x55, 
  0x00, 0x00, 0x00, 0x03, 0x04, 0x08, 0x11, 0x21, 0x11, 0x08, 0x04, 0x03,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 0x55, 
  0xfe, 0x01, 0x81, 0x41, 0x21, 0x91, 0x51, 0x51, 0x51, 0x51, 0x51, 0x51,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 0x55, 
  0x7f, 0x80, 0x80, 0x80, 0x81, 0x80, 0x82, 0x81, 0x8d, 0x8d, 0x81, 0x82,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 0xfd
};

const uint8_t* manualImages[] = {manualImage1, manualImage2, manualImage3, manualImage4, manualImage5, manualImage6, manualImage7, manualImage8,manualImage9};
const int totalManualImages = 9;

int autoImageIndex = 0;
int manualImageIndex = 0;

bool autoMode = true;  // Starts in Auto Mode
unsigned long lastImageChangeTime = 0;
unsigned long lastButtonPressTime = 0;
const unsigned long autoModeTimeout = 120000;  // 2 minutes

void sendByte(uint8_t data, bool isData) {
  digitalWrite(DC, isData ? HIGH : LOW);
  digitalWrite(CE, LOW);
  
  for (int8_t i = 7; i >= 0; i--) {
    digitalWrite(DIN, (data & (1 << i)) ? HIGH : LOW);
    digitalWrite(CLK, HIGH);
    digitalWrite(CLK, LOW);
  }
  
  digitalWrite(CE, HIGH);
}

void sendCommand(uint8_t cmd) {
  sendByte(cmd, false);
}

void sendData(uint8_t data) {
  sendByte(data, true);
}

void initDisplay() {
  digitalWrite(RST, LOW);
  delay(10);
  digitalWrite(RST, HIGH);
  delay(10);

  sendCommand(0x21);
  sendCommand(0xB8);
  sendCommand(0x04);
  sendCommand(0x14);
  sendCommand(0x20);
  sendCommand(0x0C);

  // Clear display
  for (int i = 0; i < 504; i++) {
    sendData(0x00);
  }
}

void displayImage(const uint8_t *image) {
  sendCommand(0x80 | 0);
  sendCommand(0x40 | 0);
  
  for (uint16_t i = 0; i < 504; i++) {
    sendData(image[i]);
  }
}

void handleButtons() {
  bool buttonPressed = false;
  
  if (digitalRead(BTN_UP) == LOW) {
    manualImageIndex = (manualImageIndex - 1 + totalManualImages) % totalManualImages;
    autoMode = false;
    buttonPressed = true;
    delay(200);
  }

  if (digitalRead(BTN_DOWN) == LOW) {
    manualImageIndex = (manualImageIndex + 1) % totalManualImages;
    autoMode = false;
    buttonPressed = true;
    delay(200);
  }


  if (digitalRead(BTN_SELECT) == LOW) {
    autoMode = false;
    buttonPressed = true;
    delay(200);
  }

  if (digitalRead(BTN_BACK) == LOW) {
    autoMode = false;
    buttonPressed = true;
    delay(200);
  }


  if (buttonPressed) {
    lastButtonPressTime = millis();  // Reset inactivity timer
  }
}

void autoModeCheck() {
  if (!autoMode && millis() - lastButtonPressTime > autoModeTimeout) {
    autoMode = true;
  }
}

void setup() {

  display.begin();
  display.setContrast(60);
  display.clearDisplay();
  display.setTextSize(1);
  display.setTextColor(BLACK);
  display.display();

  pinMode(RST, OUTPUT);
  pinMode(CE, OUTPUT);
  pinMode(DC, OUTPUT);
  pinMode(DIN, OUTPUT);
  pinMode(CLK, OUTPUT);

  pinMode(BTN_UP, INPUT_PULLUP);
  pinMode(BTN_DOWN, INPUT_PULLUP);
  pinMode(BTN_SELECT, INPUT_PULLUP);
  pinMode(BTN_BACK, INPUT_PULLUP);

  digitalWrite(CE, HIGH);
  digitalWrite(RST, HIGH);

  initDisplay();
}

void loop() {
  handleButtons();
  autoModeCheck();

  while(digitalRead(BTN_SELECT)==0 && manualImageIndex==0){
      for(int i=0;i<10000;i++){
            display.setCursor(0, 0);
           display.println("not supported now");
      }
  }
  while(digitalRead(BTN_SELECT)==0 && manualImageIndex==1){

   for(int i=0;i<10000;i++){
    nfcmenu();
      }
  }

     while(digitalRead(BTN_SELECT)==0 && manualImageIndex==2){

    for(int i=0;i<10000;i++){
    nfcmenu();
      }
  }
    while(digitalRead(BTN_SELECT)==0 && manualImageIndex==3){

    for(int i=0;i<10000;i++){
    nfcmenu();
      }
  }
  while(digitalRead(BTN_SELECT)==0 && manualImageIndex==4){

    for(int i=0;i<10000;i++){
    nfcmenu();
      }
  }
  while(digitalRead(BTN_SELECT)==0 && manualImageIndex==5){

    for(int i=0;i<10000;i++){
    nfcmenu();
      }
  }

  while(digitalRead(BTN_SELECT)==0 && manualImageIndex==6){

    for(int i=0;i<10000;i++){
    nfcmenu();
      }
  }

  while(digitalRead(BTN_SELECT)==0 && manualImageIndex==7){

  for(int i=0;i<10000;i++){
    nfcmenu();
      }
  }

  while(digitalRead(BTN_SELECT)==0 && manualImageIndex==8){

    for(int i=0;i<10000;i++){
    nfcmenu();
      }
  }



  if (autoMode) {
    if (millis() - lastImageChangeTime > 1000) {  // Change auto images every second
      autoImageIndex = (autoImageIndex + 1) % totalAutoImages;
      lastImageChangeTime = millis();
    }
    displayImage(autoImages[autoImageIndex]);  // Show Auto Mode images
  } else {
    displayImage(manualImages[manualImageIndex]);  // Show Manual Mode images
  }

  delay(100);
}

void handleInput() {
  if ((millis() - lastDebounceTime) < debounceDelay) return;

  if (digitalRead(BTN_UP) == LOW) {
    if (inSubMenu) {
      subMenuSelection = (subMenuSelection - 1 + 2) % 2;
    } else {
      currentSelection = (currentSelection - 1 + menuSize) % menuSize;
    }
    lastDebounceTime = millis();
  }
  else if (digitalRead(BTN_DOWN) == LOW) {
    if (inSubMenu) {
      subMenuSelection = (subMenuSelection + 1) % 2;
    } else {
      currentSelection = (currentSelection + 1) % menuSize;
    }
    lastDebounceTime = millis();
  }
  else if (digitalRead(BTN_SELECT) == LOW) {
    if (inSubMenu) {
      // Execute submenu action (currently just placeholder)
    } else {
      executeAction();
    }
    lastDebounceTime = millis();
  }
  else if (digitalRead(BTN_BACK) == LOW) {
    if (inSubMenu) {
      inSubMenu = false;
    }
    lastDebounceTime = millis();
  }
}

void drawMainMenu() {
  display.clearDisplay();
  
  for (int i = 0; i < menuSize; i++) {
    int y = i * 10; // Adjust spacing for each menu item
    if (i == currentSelection) {
      display.fillRect(0, y, 84, 10, BLACK); // Draw black rectangle for selected item
      display.setTextColor(WHITE);
    } else {
      display.setTextColor(BLACK);
    }
    display.setCursor(2, y);
    display.println(menuItems[i]);
  }
  display.display();
}

void executeAction() {
  if (currentSelection == 0) { // If "Read" is selected
    submenu();
  } else {
    inSubMenu = true;
    display.clearDisplay();
    display.setCursor(0, 0);
    
    switch (currentSelection) {
      case 1: // Write
        display.println("Writing data...");
        break;
      case 2: // Save
        display.println("Saving...");
        break;
      case 3: // Emulate
        display.println("Emulating...");
        break;
    }
    
    display.println("\nPress BACK to return");
    display.display();
    
    // Wait for BACK button press
    while (digitalRead(BTN_BACK) != LOW) {
      delay(50);
    }
    inSubMenu = false;
  }
}

void submenu() {
  inSubMenu = false;
  const char *subMenuItems[] = {"on", "off","shunt","trift"};
  
  while (inSubMenu) {
    display.clearDisplay();
    
    for (int i = 0; i < 4; i++) {
      int y = i * 10; // Adjust spacing for submenu items
       if (i == subMenuSelection) {
        display.fillRect(0, y, 84, 10, BLACK); // Draw black rectangle for selected item
        display.setTextColor(WHITE);
      } else {
        display.setTextColor(BLACK);
      }
      display.setCursor(2, y);
      display.println(subMenuItems[i]);
    }
    display.display();
    
    handleInput();
  }
}
void nfcmenu(){

handleInput();
  if (!inSubMenu) {
    drawMainMenu();
  }

   }


