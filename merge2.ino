#define LCD_X     84
#define LCD_Y     48

// Pin definitions
#define PIN_RESET 8
#define PIN_SCE   5
#define PIN_DC    4
#define PIN_SDIN  7
#define PIN_SCLK  6

#define BUTTON_UP 16
#define BUTTON_DOWN 17
#define BUTTON_SELECT 18
#define BUTTON_BACK  19// Back button on pin 19

#define led 25

#define LCD_C 0  // Command
#define LCD_D 1  // Data

// Manual images (replace these with actual image data)
const char manualImage1[] ={ 
  0xff, 0xff, 0xff, 0xff, 0xff, 0xff, 0xff, 0xff, 0xff, 0xff, 0x0f, 0x8f,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 0x00, 
  0xff, 0xff, 0xff, 0xff, 0xff, 0xff, 0x3c, 0x18, 0x81, 0xe7, 0x00, 0xcf,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 0x00, 
  0xff, 0xff, 0xff, 0xff, 0xff, 0xff, 0xff, 0xff, 0xff, 0xff, 0xe0, 0xef,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 0x00, 
  0xfe, 0x02, 0x02, 0x02, 0x02, 0x02, 0x02, 0x82, 0x42, 0x02, 0x02, 0x02,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 0x00, 
  0xff, 0x00, 0x00, 0x00, 0x00, 0x1e, 0x21, 0x5c, 0xa2, 0x59, 0x24, 0xd8,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 0x00, 
  0xff, 0x80, 0x80, 0x80, 0x80, 0x80, 0x80, 0x80, 0x80, 0x80, 0x80, 0x8f,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 0x00
};
const char manualImage2[] = { 
  0xff, 0x01, 0x01, 0x01, 0x01, 0x01, 0x01, 0x01, 0x01, 0x01, 0xf1, 0x71,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 0x00, 
  0xff, 0x00, 0x00, 0x00, 0x00, 0x00, 0xc3, 0xe7, 0x7e, 0x18, 0xff, 0x30,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 0x00, 
  0xff, 0x80, 0x80, 0x80, 0x80, 0x80, 0x80, 0x80, 0x80, 0x80, 0x9f, 0x90,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 0x00, 
  0xfe, 0x02, 0x02, 0x02, 0x02, 0x02, 0x02, 0x82, 0x42, 0x02, 0x02, 0x02,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 0x00, 
  0xff, 0x00, 0x00, 0x00, 0x00, 0x1e, 0x21, 0x5c, 0xa2, 0x59, 0x24, 0xd8,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 0x00, 
  0xff, 0x80, 0x80, 0x80, 0x80, 0x80, 0x80, 0x80, 0x80, 0x80, 0x80, 0x8f,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 0x00
};
const char manualImage3[] = { 
  0xff, 0x01, 0x01, 0x01, 0x01, 0x01, 0x01, 0x01, 0x01, 0x01, 0xf1, 0x71,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 0x00, 
  0xff, 0x00, 0x00, 0x00, 0x00, 0x00, 0xc3, 0xe7, 0x7e, 0x18, 0xff, 0x30,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 0x00, 
  0xff, 0x80, 0x80, 0x80, 0x80, 0x80, 0x80, 0x80, 0x80, 0x80, 0x9f, 0x90,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 0x00, 
  0xfe, 0x02, 0x02, 0x02, 0x02, 0x02, 0x02, 0x82, 0x42, 0x02, 0x02, 0x02,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 0x00, 
  0xff, 0x00, 0x00, 0x00, 0x00, 0x1e, 0x21, 0x5c, 0xa2, 0x59, 0x24, 0xd8,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 0x00, 
  0xff, 0x80, 0x80, 0x80, 0x80, 0x80, 0x80, 0x80, 0x80, 0x80, 0x80, 0x8f,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 0x00
};

const char manualImage4[] ={ 
  0xff, 0x01, 0x01, 0x01, 0x01, 0x01, 0x01, 0x01, 0x01, 0x01, 0xf1, 0x71,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 0x00, 
  0xff, 0x00, 0x00, 0x00, 0x00, 0x00, 0xc3, 0xe7, 0x7e, 0x18, 0xff, 0x30,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 0x00, 
  0xff, 0x80, 0x80, 0x80, 0x80, 0x80, 0x80, 0x80, 0x80, 0x80, 0x9f, 0x90,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 0x00, 
  0xfe, 0xfe, 0xfe, 0xfe, 0xfe, 0xfe, 0xfe, 0x7e, 0xbe, 0xfe, 0xfe, 0xfe,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 0x00, 
  0xff, 0xff, 0xff, 0xff, 0xff, 0xe1, 0xde, 0xa3, 0x5d, 0xa6, 0xdb, 0x27,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 0x00, 
  0xff, 0xff, 0xff, 0xff, 0xff, 0xff, 0xff, 0xff, 0xff, 0xff, 0xff, 0xf0,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 0x00
};

const char manualImage5[] ={ 
  0xff, 0x01, 0x01, 0x01, 0x01, 0x01, 0x01, 0x01, 0x01, 0x01, 0xf1, 0x71,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 0x00, 
  0xff, 0x00, 0x00, 0x00, 0x00, 0x00, 0xc3, 0xe7, 0x7e, 0x18, 0xff, 0x30,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 0x00, 
  0xff, 0x80, 0x80, 0x80, 0x80, 0x80, 0x80, 0x80, 0x80, 0x80, 0x9f, 0x90,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 0x00, 
  0xfe, 0x02, 0x02, 0x02, 0x02, 0x02, 0x02, 0x82, 0x42, 0x02, 0x02, 0x02,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 0x00, 
  0xff, 0x00, 0x00, 0x00, 0x00, 0x1e, 0x21, 0x5c, 0xa2, 0x59, 0x24, 0xd8,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 0x00, 
  0xff, 0x80, 0x80, 0x80, 0x80, 0x80, 0x80, 0x80, 0x80, 0x80, 0x80, 0x8f,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 0x00
};

const char manualImage6[] ={ 
  0xff, 0x01, 0x01, 0x01, 0x01, 0x01, 0x01, 0x01, 0x01, 0x01, 0xf1, 0x71,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 0x00, 
  0xff, 0x00, 0x00, 0x00, 0x00, 0x00, 0xc3, 0xe7, 0x7e, 0x18, 0xff, 0x30,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 0x00, 
  0xff, 0x80, 0x80, 0x80, 0x80, 0x80, 0x80, 0x80, 0x80, 0x80, 0x9f, 0x90,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 0x00, 
  0xfe, 0x02, 0x02, 0x02, 0x02, 0x02, 0x02, 0x82, 0x42, 0x02, 0x02, 0x02,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 0x00, 
  0xff, 0x00, 0x00, 0x00, 0x00, 0x1e, 0x21, 0x5c, 0xa2, 0x59, 0x24, 0xd8,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 0x00, 
  0xff, 0x80, 0x80, 0x80, 0x80, 0x80, 0x80, 0x80, 0x80, 0x80, 0x80, 0x8f,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 0x00
};


// Automatic images (replace these with actual image data)
const char autoImage1[] = { 
  0xff, 0xff, 0xff, 0xff, 0xff, 0xff, 0xff, 0xff, 0xff, 0xff, 0xfb, 0xff,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 0xff, 
  0xff, 0xff, 0xff, 0xff, 0xff, 0xff, 0xff, 0xff, 0xff, 0xff, 0xff, 0xff,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 0xbf, 
  0xff, 0xff, 0xff, 0xff, 0xff, 0xff, 0xff, 0x7f, 0x9f, 0xef, 0x33, 0x1d,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 0x43, 
  0xff, 0xff, 0xff, 0x7f, 0x8f, 0xf3, 0x1c, 0x07, 0x01, 0x00, 0x00, 0x00,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 0x10, 
  0xff, 0x8f, 0xf3, 0x5c, 0xc7, 0x80, 0x00, 0x00, 0x00, 0x00, 0x00, 0x00,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 0x02, 
  0xff, 0xff, 0xff, 0xff, 0xfe, 0xfd, 0xfb, 0xf6, 0xec, 0xf8, 0xd8, 0xf0,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 0x48
};
const char autoImage2[] = { 
  0xff, 0xff, 0xff, 0xff, 0xff, 0xff, 0xff, 0xff, 0xff, 0xfb, 0xf1, 0xfb,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 0xff, 
  0xff, 0xff, 0xff, 0xdf, 0xff, 0xff, 0xff, 0xff, 0xff, 0xff, 0xff, 0xff,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 0xbf, 
  0xff, 0xff, 0xff, 0xff, 0xff, 0xff, 0xff, 0x7f, 0x9f, 0xef, 0x33, 0x1d,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 0x43, 
  0xff, 0xff, 0xff, 0x7f, 0x8f, 0xf3, 0x1c, 0x07, 0x01, 0x00, 0x00, 0x00,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 0x10, 
  0xff, 0x8f, 0xf3, 0x5c, 0xc7, 0x80, 0x00, 0x00, 0x00, 0x00, 0x00, 0x00,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 0x02, 
  0xff, 0xff, 0xff, 0xff, 0xfe, 0xfd, 0xfb, 0xf6, 0xec, 0xf8, 0xd8, 0xf0,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 0x48
};
const char autoImage3[] = { 
  0xff, 0xff, 0xff, 0xff, 0xff, 0xff, 0xff, 0xff, 0xff, 0xff, 0xfb, 0xff,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 0xff, 
  0xff, 0xff, 0xdf, 0x8f, 0xdf, 0xff, 0xff, 0xff, 0xff, 0xff, 0xff, 0xff,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 0xbf, 
  0xff, 0xff, 0xff, 0xff, 0xff, 0xff, 0xff, 0x7f, 0x9f, 0xef, 0x33, 0x1d,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 0x43, 
  0xff, 0xff, 0xff, 0x7f, 0x8f, 0xf3, 0x1c, 0x07, 0x01, 0x00, 0x00, 0x00,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 0x10, 
  0xff, 0x8f, 0xf3, 0x5c, 0xc7, 0x80, 0x00, 0x00, 0x00, 0x00, 0x00, 0x00,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 0x02, 
  0xff, 0xff, 0xff, 0xff, 0xfe, 0xfd, 0xfb, 0xf6, 0xec, 0xf8, 0xd8, 0xf0,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 0x48
};






// Arrays of images
const char* manualImages[] = {manualImage1, manualImage2, manualImage3, manualImage4, manualImage5, manualImage6};
const char* autoImages[] = {autoImage1, autoImage2, autoImage3};

// Image counters
int totalManualImages = sizeof(manualImages) / sizeof(manualImages[0]);
int totalAutoImages = sizeof(autoImages) / sizeof(autoImages[0]);

int currentManualImage = 0;
int currentAutoImage = 0;

bool autoMode = true;  // Start in automatic mode
unsigned long lastButtonPressTime = 0;  // Time of the last button press
const unsigned long timeoutDuration = 120000;  // 2 minutes (in milliseconds)

void setup() {
  LcdInitialise();
  LcdClear();
  pinMode(led ,OUTPUT);
  pinMode(BUTTON_UP, INPUT_PULLUP);
  pinMode(BUTTON_DOWN, INPUT_PULLUP);
  pinMode(BUTTON_SELECT, INPUT_PULLUP);
  pinMode(BUTTON_BACK, INPUT_PULLUP);  // Initialize back button

  // Display the first automatic image
  displayAutoImage(currentAutoImage);
}

void loop() {
  unsigned long currentTime = millis();

  if (autoMode) {
    // Automatic mode: Loop through automatic images
    currentAutoImage = (currentAutoImage + 1) % totalAutoImages;  // Next image
    displayAutoImage(currentAutoImage);
    delay(1000);  // Wait 1 second

    // Check if any button is pressed to exit auto mode
    if (digitalRead(BUTTON_UP) == LOW || digitalRead(BUTTON_DOWN) == LOW || digitalRead(BUTTON_SELECT) == LOW || digitalRead(BUTTON_BACK) == LOW) {
      autoMode = false;  // Switch to manual mode
      lastButtonPressTime = currentTime;  // Update last button press time
      delay(200);        // Debounce delay
      displayManualImage(currentManualImage);  // Display the current manual image
    }
  } else {
    // Manual mode: Control with buttons
    if (digitalRead(BUTTON_UP) == LOW) {
      currentManualImage = (currentManualImage - 1 + totalManualImages) % totalManualImages;  // Previous image
      displayManualImage(currentManualImage);
      lastButtonPressTime = currentTime;  // Update last button press time
      delay(200);  // Debounce delay
    }
    if (digitalRead(BUTTON_DOWN) == LOW) {
      currentManualImage = (currentManualImage + 1) % totalManualImages;  // Next image
      displayManualImage(currentManualImage);
      lastButtonPressTime = currentTime;  // Update last button press time
      delay(200);  // Debounce delay
    }
    if ( ( currentManualImage == 0) && digitalRead (BUTTON_SELECT) == LOW) {
   
     digitalWrite(led,HIGH);
      delay(1000);      
      digitalWrite(led,LOW);        
    }
    if ( ( currentManualImage == 1) && digitalRead (BUTTON_SELECT) == LOW) {
   
       digitalWrite(led,HIGH);
       delay(1000);       
       digitalWrite(led,LOW);        
    }
    if ( ( currentManualImage == 2) && digitalRead (BUTTON_SELECT) == LOW) {
   
     digitalWrite(led,HIGH);
      delay(1000);       
     digitalWrite(led,LOW);        
    }
    if ( ( currentManualImage == 3) && digitalRead (BUTTON_SELECT) == LOW) {
   
     digitalWrite(led,HIGH);
      delay(1000);       
     digitalWrite(led,LOW);        
    }
    if ( ( currentManualImage == 4) && digitalRead (BUTTON_SELECT) == LOW) {
   
     digitalWrite(led,HIGH);
      delay(1000);       
     digitalWrite(led,LOW);        
    }
if ( ( currentManualImage == 5) && digitalRead (BUTTON_SELECT) == LOW) {
   
     digitalWrite(led,HIGH);
      delay(1000);       
     digitalWrite(led,LOW);        
    }


    if (digitalRead(BUTTON_BACK) == LOW) {
      autoMode = true;  // Back button pressed, return to automatic mode
      delay(200);       // Debounce delay
      displayAutoImage(currentAutoImage);  // Display the current automatic image
    }

    // Check if no button has been pressed for the timeout duration
    if (currentTime - lastButtonPressTime > timeoutDuration) {
      autoMode = true;  // Return to automatic mode
      displayAutoImage(currentAutoImage);  // Display the current automatic image
    }
  }
}

// Display a manual image
void displayManualImage(int index) {
  LcdClear();
  gotoXY(0, 0);  // Ensure image starts from the top-left corner
  LcdBitmap(manualImages[index]);
}

// Display an automatic image
void displayAutoImage(int index) {
  LcdClear();
  gotoXY(0, 0);  // Ensure image starts from the top-left corner
  LcdBitmap(autoImages[index]);
}

// LCD Procedures  
void LcdClear(void) {
  for (int index = 0; index < LCD_X * LCD_Y / 8; index++) {
    LcdWrite(LCD_D, 0x00);
  }
}

void LcdInitialise(void) {
  pinMode(PIN_SCE, OUTPUT);
  pinMode(PIN_RESET, OUTPUT);
  pinMode(PIN_DC, OUTPUT);
  pinMode(PIN_SDIN, OUTPUT);
  pinMode(PIN_SCLK, OUTPUT);
  digitalWrite(PIN_RESET, LOW);
  digitalWrite(PIN_RESET, HIGH);

  LcdWrite(LCD_C, 0x21);  // LCD Extended Commands
  LcdWrite(LCD_C, 0xB1);  // Set LCD Vop (Contrast)
  LcdWrite(LCD_C, 0x04);  // Set Temp coefficient
  LcdWrite(LCD_C, 0x14);  // LCD bias mode 1:48
  LcdWrite(LCD_C, 0x0C);  // LCD in normal mode
  LcdWrite(LCD_C, 0x20);
  LcdWrite(LCD_C, 0x0C);
}

void gotoXY(int x, int y) {
  LcdWrite(LCD_C, 0x80 | x);  // Column
  LcdWrite(LCD_C, 0x40 | y);  // Row
}

void LcdWrite(byte dc, byte data) {
  digitalWrite(PIN_DC, dc);
  digitalWrite(PIN_SCE, LOW);
  shiftOut(PIN_SDIN, PIN_SCLK, MSBFIRST, data);
  digitalWrite(PIN_SCE, HIGH);
}

void LcdBitmap(const char my_array[]) {
  for (int index = 0; index < (LCD_X * LCD_Y / 8); index++) {
    LcdWrite(LCD_D, my_array[index]);
  }
}
