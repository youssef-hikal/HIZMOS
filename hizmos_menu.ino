#define LCD_X     84
#define LCD_Y     48

// Pin definitions
#define PIN_RESET 8
#define PIN_SCE   5
#define PIN_DC    4
#define PIN_SDIN  7
#define PIN_SCLK  6

#define BUTTON_UP 16
#define BUTTON_DOWN 17
#define BUTTON_SELECT 18

// LCD Command/Data Mode
#define LCD_C 0  // Command
#define LCD_D 1  // Data

// Bitmap images (84x48 pixel example images; replace these with actual image data)
const char image1[] = { 
  0xff, 0xff, 0xff, 0xff, 0xff, 0xff, 0x9f, 0x1f, 0x3f, 0xff, 0x01, 0xf1,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 0x00, 
  0xff, 0xff, 0xff, 0xff, 0xff, 0xff, 0xe7, 0xe3, 0xf0, 0xfc, 0x00, 0xf9,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 0x00, 
  0xff, 0xff, 0xff, 0xff, 0xff, 0x01, 0x6d, 0x13, 0xff, 0x83, 0xbc, 0xbd,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 0x00, 
  0xfe, 0x02, 0x02, 0x02, 0xe2, 0x12, 0xca, 0x26, 0x92, 0x42, 0x82, 0x42,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 0x00, 
  0xff, 0x00, 0x00, 0x00, 0x01, 0x02, 0x05, 0x0a, 0x05, 0x02, 0xfd, 0x02,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 0x00, 
  0xff, 0x80, 0x80, 0x80, 0xcc, 0x92, 0x92, 0xe4, 0x80, 0xf8, 0x80, 0x80,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 0x00
};


const char image2[] ={ 
  0xff, 0x01, 0x01, 0x01, 0x01, 0x01, 0x61, 0xe1, 0xc1, 0x01, 0xff, 0x07,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 0x00, 
  0xff, 0x00, 0x00, 0x00, 0x00, 0x00, 0x18, 0x1c, 0x0f, 0x03, 0xff, 0x06,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 0x00, 
  0xff, 0x80, 0x80, 0x80, 0x80, 0xfe, 0x92, 0xec, 0x80, 0xfc, 0xc3, 0xc2,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 0x00, 
  0xfe, 0x02, 0x02, 0x02, 0xe2, 0x12, 0xca, 0x26, 0x92, 0x42, 0x82, 0x42,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 0x00, 
  0xff, 0x00, 0x00, 0x00, 0x01, 0x02, 0x05, 0x0a, 0x05, 0x02, 0xfd, 0x02,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 0x00, 
  0xff, 0x80, 0x80, 0x80, 0xcc, 0x92, 0x92, 0xe4, 0x80, 0xf8, 0x80, 0x80,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 0x00
};


const char image3[] = { 
  0xff, 0x01, 0x01, 0x01, 0x01, 0x01, 0x61, 0xe1, 0xc1, 0x01, 0xff, 0x07,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 0x00, 
  0xff, 0x00, 0x00, 0x00, 0x00, 0x00, 0x18, 0x1c, 0x0f, 0x03, 0xff, 0x06,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 0x00, 
  0xff, 0x80, 0x80, 0x80, 0x80, 0xfe, 0x92, 0xec, 0x80, 0xfc, 0xc3, 0xc2,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 0x00, 
  0xfe, 0x02, 0x02, 0x02, 0xe2, 0x12, 0xca, 0x26, 0x92, 0x42, 0x82, 0x42,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 0x00, 
  0xff, 0x00, 0x00, 0x00, 0x01, 0x02, 0x05, 0x0a, 0x05, 0x02, 0xfd, 0x02,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 0x00, 
  0xff, 0x80, 0x80, 0x80, 0xcc, 0x92, 0x92, 0xe4, 0x80, 0xf8, 0x80, 0x80,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 0x00
};

const char image4[] ={ 
  0xff, 0x01, 0x01, 0x01, 0x01, 0x01, 0x61, 0xe1, 0xc1, 0x01, 0xff, 0x07,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 0x00, 
  0xff, 0x00, 0x00, 0x00, 0x00, 0x00, 0x18, 0x1c, 0x0f, 0x03, 0xff, 0x06,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 0x00, 
  0xff, 0x80, 0x80, 0x80, 0x80, 0xfe, 0x92, 0xec, 0x80, 0xfc, 0xc3, 0xc2,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 0x00, 
  0xfe, 0xfe, 0xfe, 0xfe, 0x1e, 0xee, 0x36, 0xda, 0x6e, 0xbe, 0x7e, 0xbe,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 0x00, 
  0xff, 0xff, 0xff, 0xff, 0xfe, 0xfd, 0xfa, 0xf5, 0xfa, 0xfd, 0x02, 0xfd,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 0x00, 
  0xff, 0xff, 0xff, 0xff, 0xb3, 0xed, 0xed, 0x9b, 0xff, 0x87, 0xff, 0xff,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 0x00
};

const char image5[] ={ 
  0xff, 0x01, 0x01, 0x01, 0x01, 0x01, 0x61, 0xe1, 0xc1, 0x01, 0xff, 0x07,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 0x00, 
  0xff, 0x00, 0x00, 0x00, 0x00, 0x00, 0x18, 0x1c, 0x0f, 0x03, 0xff, 0x06,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 0x00, 
  0xff, 0x80, 0x80, 0x80, 0x80, 0xfe, 0x92, 0xec, 0x80, 0xfc, 0xc3, 0xc2,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 0x00, 
  0xfe, 0x02, 0x02, 0x02, 0xe2, 0x12, 0xca, 0x26, 0x92, 0x42, 0x82, 0x42,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 0x00, 
  0xff, 0x00, 0x00, 0x00, 0x01, 0x02, 0x05, 0x0a, 0x05, 0x02, 0xfd, 0x02,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 0x00, 
  0xff, 0x80, 0x80, 0x80, 0xcc, 0x92, 0x92, 0xe4, 0x80, 0xf8, 0x80, 0x80,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 0x00
};

const char image6[] = { 
  0xff, 0x01, 0x01, 0x01, 0x01, 0x01, 0x61, 0xe1, 0xc1, 0x01, 0xff, 0x07,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 0x00, 
  0xff, 0x00, 0x00, 0x00, 0x00, 0x00, 0x18, 0x1c, 0x0f, 0x03, 0xff, 0x06,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 0x00, 
  0xff, 0x80, 0x80, 0x80, 0x80, 0xfe, 0x92, 0xec, 0x80, 0xfc, 0xc3, 0xc2,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 0x00, 
  0xfe, 0x02, 0x02, 0x02, 0xe2, 0x12, 0xca, 0x26, 0x92, 0x42, 0x82, 0x42,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 0x00, 
  0xff, 0x00, 0x00, 0x00, 0x01, 0x02, 0x05, 0x0a, 0x05, 0x02, 0xfd, 0x02,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 0x00, 
  0xff, 0x80, 0x80, 0x80, 0xcc, 0x92, 0x92, 0xe4, 0x80, 0xf8, 0x80, 0x80,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 0x00
};




const char image7[] = { 
  0xff, 0xff, 0xff, 0xff, 0xff, 0xff, 0x9f, 0x1f, 0x3f, 0xff, 0x01, 0xf1,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 0x00, 
  0xff, 0xff, 0xff, 0xff, 0xff, 0xff, 0xe7, 0xe3, 0xf0, 0xfc, 0x00, 0xf9,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 0x00, 
  0xff, 0xff, 0xff, 0xff, 0xff, 0x01, 0x6d, 0x13, 0xff, 0x83, 0xbc, 0xbd,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 0x00, 
  0xfe, 0x02, 0x02, 0x02, 0xe2, 0x12, 0xca, 0x26, 0x92, 0x42, 0x82, 0x42,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 0x00, 
  0xff, 0x00, 0x00, 0x00, 0x01, 0x02, 0x05, 0x0a, 0x05, 0x02, 0xfd, 0x02,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 0x00, 
  0xff, 0x80, 0x80, 0x80, 0xcc, 0x92, 0x92, 0xe4, 0x80, 0xf8, 0x80, 0x80,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 0x00
};


const char image8[] = { 
  0xff, 0x01, 0x01, 0x01, 0x01, 0x01, 0x61, 0xe1, 0xc1, 0x01, 0xff, 0x07,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 0x00, 
  0xff, 0x00, 0x00, 0x00, 0x00, 0x00, 0x18, 0x1c, 0x0f, 0x03, 0xff, 0x06,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 0x00, 
  0xff, 0x80, 0x80, 0x80, 0x80, 0xfe, 0x92, 0xec, 0x80, 0xfc, 0xc3, 0xc2,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 0x00, 
  0xfe, 0xfe, 0xfe, 0xfe, 0x1e, 0xee, 0x36, 0xda, 0x6e, 0xbe, 0x7e, 0xbe,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 0x00, 
  0xff, 0xff, 0xff, 0xff, 0xfe, 0xfd, 0xfa, 0xf5, 0xfa, 0xfd, 0x02, 0xfd,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 0x00, 
  0xff, 0xff, 0xff, 0xff, 0xb3, 0xed, 0xed, 0x9b, 0xff, 0x87, 0xff, 0xff,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 0x00
};

const char image9[] = { 
  0xff, 0x01, 0x01, 0x01, 0x01, 0x01, 0x61, 0xe1, 0xc1, 0x01, 0xff, 0x07,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 0x00, 
  0xff, 0x00, 0x00, 0x00, 0x00, 0x00, 0x18, 0x1c, 0x0f, 0x03, 0xff, 0x06,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 0x00, 
  0xff, 0x80, 0x80, 0x80, 0x80, 0xfe, 0x92, 0xec, 0x80, 0xfc, 0xc3, 0xc2,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 0x00, 
  0xfe, 0x02, 0x02, 0x02, 0xe2, 0x12, 0xca, 0x26, 0x92, 0x42, 0x82, 0x42,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 0x00, 
  0xff, 0x00, 0x00, 0x00, 0x01, 0x02, 0x05, 0x0a, 0x05, 0x02, 0xfd, 0x02,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 0x00, 
  0xff, 0x80, 0x80, 0x80, 0xcc, 0x92, 0x92, 0xe4, 0x80, 0xf8, 0x80, 0x80,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 0x00
};



// Array of images
const char* images[] = {image1, image2, image3 , image4, image5, image6, image7, image8, image9};
int totalImages = sizeof(images) / sizeof(images[0]);
int currentImage = 0;

void setup() {
  // Initialize display and buttons
  LcdInitialise();
  LcdClear();
  
  pinMode(BUTTON_UP, INPUT_PULLDOWN);
  pinMode(BUTTON_DOWN, INPUT_PULLDOWN);
  pinMode(BUTTON_SELECT, INPUT_PULLDOWN);

  // Display the first image
  displayImage(currentImage);
}

void loop() {
  // Check if the UP button is pressed
  if (digitalRead(BUTTON_UP) == HIGH) {
    currentImage = (currentImage - 1 + totalImages) % totalImages;  // Previous image
    displayImage(currentImage);
    delay(200);  // Debounce delay
  }

  // Check if the DOWN button is pressed
  if (digitalRead(BUTTON_DOWN) == HIGH) {
    currentImage = (currentImage + 1) % totalImages;  // Next image
    displayImage(currentImage);
    delay(200);  // Debounce delay
  }

  // Check if the SELECT button is pressed
  if (digitalRead(BUTTON_SELECT) == HIGH) {
    // Optional: Add functionality for SELECT button

    Serial.print("Selected image: ");
    Serial.println(currentImage);
    delay(200);  // Debounce delay
  }
}

// Display the specified image
void displayImage(int index) {
  LcdClear();
  gotoXY(0, 0);           // Ensure image starts from the top-left corner
  LcdBitmap(images[index]);
}

// LCD Procedures  
void LcdClear(void) {
  for (int index = 0; index < LCD_X * LCD_Y / 8; index++) {
    LcdWrite(LCD_D, 0x00);
  }
}

void LcdInitialise(void) {
  pinMode(PIN_SCE, OUTPUT);
  pinMode(PIN_RESET, OUTPUT);
  pinMode(PIN_DC, OUTPUT);
  pinMode(PIN_SDIN, OUTPUT);
  pinMode(PIN_SCLK, OUTPUT);
  digitalWrite(PIN_RESET, LOW);
  digitalWrite(PIN_RESET, HIGH);

  LcdWrite(LCD_C, 0x21);  // LCD Extended Commands
  LcdWrite(LCD_C, 0xB1);  // Set LCD Vop (Contrast)
  LcdWrite(LCD_C, 0x04);  // Set Temp coefficient
  LcdWrite(LCD_C, 0x14);  // LCD bias mode 1:48
  LcdWrite(LCD_C, 0x0C);  // LCD in normal mode
  LcdWrite(LCD_C, 0x20);
  LcdWrite(LCD_C, 0x0C);
}

void gotoXY(int x, int y) {
  LcdWrite(LCD_C, 0x80 | x);  // Column
  LcdWrite(LCD_C, 0x40 | y);  // Row
}

void LcdWrite(byte dc, byte data) {
  digitalWrite(PIN_DC, dc);
  digitalWrite(PIN_SCE, LOW);
  shiftOut(PIN_SDIN, PIN_SCLK, MSBFIRST, data);
  digitalWrite(PIN_SCE, HIGH);
}

void LcdBitmap(const char my_array[]) {
  for (int index = 0; index < (LCD_X * LCD_Y / 8); index++) {
    LcdWrite(LCD_D, my_array[index]);
  }
}
